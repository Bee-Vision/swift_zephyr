## dts/bindings/modem/quectel,bg9x.yaml
```yaml
# Copyright (c) 2020 Analog Life LLC
# SPDX-License-Identifier: Apache-2.0

description: quectel BG9x modem

compatible: "quectel,bg9x"

include: [uart-device.yaml, power.yaml]

properties:
    label:
      required: true

    mdm-power-gpios:
      type: phandle-array
      required: true

    mdm-reset-gpios:
      type: phandle-array
      required: true

    mdm-dtr-gpios:
      type: phandle-array
      required: false

    mdm-wdisable-gpios:
      type: phandle-array
      required: false

    mdm-usb-boot-gpios:
      type: phandle-array
      required: false

    mdm-boot-config-gpios:
      type: phandle-array
      required: false

    mdm-pon-trig-gpios:
      type: phandle-array
      required: false
```
